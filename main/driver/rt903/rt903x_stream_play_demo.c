#include "i2c_adapter.h"
#include "rt903x_reg.h"
#include "rt903x.h"
#include "ics_util.h"
#include "string.h"
#include <stdint.h>

#define ARRAY_LENGTH(a) (sizeof(a) / sizeof(a[0]))
static const int8_t one_6k[]=
{1,1,1,0,1,1,0,-1,0,0,-1,-1,0,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-1,0};
static const int8_t three_6k[]=
{0,0,-1,-1,1,-1,-1,2,-1,0,-1,-1,-1,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0,0};
static const int8_t two_6k[]=
{-2,-2,1,-2,3,5,-5,-1,4,-2,6,-3,-6,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1,0};
static const int8_t eight_6k[]=
{0,0,0,-1,-1,-1,0,1,1,1,-1,-1,1,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0,0};
static const int8_t five_6k[]=
{-1,-1,-1,-1,-1,-1,0,0,-2,-1,0,0,0,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0,0};
static const int8_t four_6k[]=
{-2,-1,2,0,0,-2,-1,0,0,0,-3,-1,1,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-1,0};
static const int8_t seven_6k[]=
{0,0,0,0,-1,0,0,0,0,0,0,-1,0,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0,0};
static const int8_t six_6k[]=
{-1,0,-1,0,1,-1,0,0,-4,-1,0,0,2,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0,0};


// static const int8_t sin_2k_effect[]=
// {0,47,-97,-4,127,-127,-1,127,-127,0,127,-127,0,127,-127,0,127,-127,0,127,-127,0,127,-127,
// 0,127,-127,0,127,-127,0,127,-127,-1,127,-127,-1,127,-127,-1,127,-127,-1,127,-127,0,127,-127,0,127,-127,0,127,-127,
// 0,127,-127,0,127,-127,0,127,-127,0,127,-127,0,127,-127,0,127,-127,0,127,-127,0,127,-127,0,127,-127,0,127,-127,0,127,
// -127,0,127,-127,0,127,-127,0,127,-127,-1,127,-127,-1,127,-127,-1,127,-127,0,127,-127,0,127,-127,0,127,-127,0,127,
// -127,0,127,-127,0,127,-127,0,127,-127,0,127,-127,0,127,-127,0,127,-127,0,127,-127,0,127,-127,0,127,-127,0,122,-110,
// -1,55,-26,-2,0};

static const int8_t* effect_play_index[] = 
{
	one_6k,
	two_6k,
	three_6k,
    four_6k,
    five_6k,
    six_6k,
    seven_6k,
    eight_6k,
};

static const uint32_t effect_play_index_len[] = 
{
	ARRAY_LENGTH(one_6k),
	ARRAY_LENGTH(two_6k),
	ARRAY_LENGTH(three_6k),
	ARRAY_LENGTH(four_6k),
    ARRAY_LENGTH(five_6k),
    ARRAY_LENGTH(six_6k),
    ARRAY_LENGTH(seven_6k),
    ARRAY_LENGTH(eight_6k),
};

uint8_t stream_demo_flag = 0;
uint32_t data_demo_index = 0;

int32_t stream_play_demo_proc(DEF_RT903_INFO i2c_config, const uint8_t *stream_data, uint32_t stream_data_len)
{
    uint8_t reg_val = 0;
    while (1)
    {
        int16_t res = I2CReadReg(i2c_config.i2c_master_num, i2c_config.i2c_address, REG_INT_STATUS, &reg_val, 1);
        CHECK_ERROR_RETURN(res);
        if ((reg_val & BIT_INTS_PLAYDONE) > 0)
        {
            return 0;
        }
        if ((reg_val & BIT_INTS_FIFO_AF) > 0)
        {
            stream_demo_flag = 0;
        }
        if ((reg_val & BIT_INTS_FIFO_AE) > 0)
        {
            stream_demo_flag = 1;
        }
        if (stream_demo_flag == 1)
        {
            stream_demo_flag = 0;
            int32_t stream_size = ((rt903x_config.ram_param.ListBaseAddrH << 8) | rt903x_config.ram_param.ListBaseAddrL)
                - ((rt903x_config.ram_param.FifoAEH << 8) | rt903x_config.ram_param.FifoAEL);
            stream_size = min(stream_data_len - data_demo_index, stream_size);
            res = rt903x_stream_data(i2c_config, (const uint8_t*)stream_data + data_demo_index, stream_size);
            CHECK_ERROR_RETURN(res);
            data_demo_index += stream_size;
            if (data_demo_index >= stream_data_len)
            {
                break;
            }
        }
        ics_delay_ms(1);
    }
    return 0;
}

int32_t rt903x_stream_play_demo(DEF_RT903_INFO i2c_config, const uint8_t *stream_data, uint32_t stream_data_len)
{
    int32_t res = 0;
    uint8_t regvalue = 0x01;
    res = I2CWriteReg(i2c_config.i2c_master_num, i2c_config.i2c_address, REG_RAM_CFG, &regvalue, 1);
    // Clear all interruptions
    res = rt903x_clear_int(i2c_config);
    CHECK_ERROR_RETURN(res);
    res = rt903x_gain(i2c_config, 0x80);
    CHECK_ERROR_RETURN(res);
    res = rt903x_boost_voltage(i2c_config, BOOST_VOUT_850);
    CHECK_ERROR_RETURN(res);
    res = rt903x_play_mode(i2c_config, MODE_STREAM_PLAY);
    CHECK_ERROR_RETURN(res);
    res = rt903x_go(i2c_config, 1);
    CHECK_ERROR_RETURN(res);
    int32_t stream_size = (rt903x_config.ram_param.ListBaseAddrH << 8) | rt903x_config.ram_param.ListBaseAddrL;
    stream_size = min(stream_data_len, stream_size);
    res = rt903x_stream_data(i2c_config,  (const uint8_t*)stream_data, stream_size);
    CHECK_ERROR_RETURN(res);
    data_demo_index += stream_size;
    res = stream_play_demo_proc(i2c_config, (const uint8_t*)stream_data, stream_data_len);
    CHECK_ERROR_RETURN(res);
	data_demo_index = 0;
	
    return 0;
}

int rt903x_stream_play_effect(DEF_RT903_INFO i2c_config, uint8_t index){
    rt903x_stream_play_demo(i2c_config, (const uint8_t*)effect_play_index[index], effect_play_index_len[index]);
    return 0;
}
