## main/Kconfig.projbuild
```kconfig
# put here your custom config value
menu "Example Configuration"
config ESP_WIFI_SSID
    string "WiFi SSID"
    default "myssid"
    help
	SSID (network name) for the example to connect to.

config ESP_WIFI_PASSWORD
    string "WiFi Password"
    default "mypassword"
    help
	WiFi password (WPA or WPA2) for the example to use.

config I2C_MASTER_SCL
    int "SCL GPIO Num"
    default 6 if IDF_TARGET_ESP32C3 || IDF_TARGET_ESP32C2 || IDF_TARGET_ESP32H2
    default 2 if  IDF_TARGET_ESP32S3
    default 19 if IDF_TARGET_ESP32 || IDF_TARGET_ESP32S2
    help
        GPIO number for I2C Master clock line.

config I2C_MASTER_SDA
    int "SDA GPIO Num"
    default 5 if IDF_TARGET_ESP32C3 || IDF_TARGET_ESP32C2 || IDF_TARGET_ESP32H2
    default 1 if  IDF_TARGET_ESP32S3
    default 18 if IDF_TARGET_ESP32 || IDF_TARGET_ESP32S2
    help
        GPIO number for I2C Master data line.

config I2C_MASTER_0_SCL
    int "SCL GPIO Num"
    default 6 if IDF_TARGET_ESP32C3 || IDF_TARGET_ESP32C2 || IDF_TARGET_ESP32H2
    default 38 if  IDF_TARGET_ESP32S3
    default 19 if IDF_TARGET_ESP32 || IDF_TARGET_ESP32S2
    help
        GPIO number for I2C Master clock line.

config I2C_MASTER_0_SDA
    int "SDA GPIO Num"
    default 5 if IDF_TARGET_ESP32C3 || IDF_TARGET_ESP32C2 || IDF_TARGET_ESP32H2
    default 37 if  IDF_TARGET_ESP32S3
    default 18 if IDF_TARGET_ESP32 || IDF_TARGET_ESP32S2
    help
        GPIO number for I2C Master data line.    

config I2C_MASTER_1_SCL
    int "SCL GPIO Num"
    default 6 if IDF_TARGET_ESP32C3 || IDF_TARGET_ESP32C2 || IDF_TARGET_ESP32H2
    default 36 if  IDF_TARGET_ESP32S3
    default 19 if IDF_TARGET_ESP32 || IDF_TARGET_ESP32S2
    help
        GPIO number for I2C Master clock line.

config I2C_MASTER_1_SDA
    int "SDA GPIO Num"
    default 5 if IDF_TARGET_ESP32C3 || IDF_TARGET_ESP32C2 || IDF_TARGET_ESP32H2
    default 35 if  IDF_TARGET_ESP32S3
    default 18 if IDF_TARGET_ESP32 || IDF_TARGET_ESP32S2
    help
        GPIO number for I2C Master data line.        


endmenu
```
